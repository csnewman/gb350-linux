## kernel/drivers/gpio/Kconfig.gb350
```kconfig
config GPIO_HC16XX
	bool "HiChip HC16xx GPIO"
	depends on GPIOLIB && OF && HAS_IOMEM
	select GPIOLIB_IRQCHIP
	help
	  GPIO banks of the HiChip HC16xx SoCs (GB350).
```

## kernel/drivers/gpu/drm/hichip/Kconfig
```kconfig
config DRM_HC16XX
	bool "HiChip HC16xx display (GMA layers)"
	depends on DRM && OF
	select APERTURE_HELPERS
	select DRM_CLIENT_SELECTION
	select DRM_GEM_DMA_HELPER
	select DRM_KMS_HELPER
	select VIDEOMODE_HELPERS
	help
	  KMS driver for the graphics layers of the HiChip HC16xx display
	  engine (GB350 handheld): two scaled planes on the panel the
	  bootloader sets up.
```

## kernel/drivers/iio/adc/Kconfig.gb350
```kconfig
config HC16XX_ADC
	bool "HiChip HC16xx SAR ADC"
	depends on IIO && OF && HAS_IOMEM
	help
	  The 8-bit SAR ADC of the HiChip HC16xx SoCs (battery and charge
	  sensing on the GB350).
```

## kernel/drivers/input/keyboard/Kconfig.gb350
```kconfig
config KEYBOARD_GB350
	bool "GB350 button shift register"
	depends on INPUT_KEYBOARD && GPIOLIB
	help
	  The d-pad/ABXY/L1/R1/Select/Start buttons of the GB350 handheld,
	  read through a shift register on two GPIOs.

config KEYBOARD_GB350_SYSCORE
	bool "GB350 buttons via the second core (syscore)"
	depends on INPUT_KEYBOARD && OF
	help
	  All GB350 buttons and switches, scanned by the gb350-syscore firmware on the
	  SoC's second core and delivered as messages (gb350-syscore).
```

## kernel/drivers/power/supply/Kconfig.gb350
```kconfig
config BATTERY_GB350
	bool "GB350 battery"
	depends on POWER_SUPPLY && IIO
	help
	  Battery level and charge status of the GB350 handheld, read from
	  two ADC channels.
```

## kernel/drivers/pwm/Kconfig.gb350
```kconfig
config PWM_HC16XX
	bool "HiChip HC16xx PWM"
	depends on OF && HAS_IOMEM
	help
	  The six-channel PWM of HiChip HC16xx SoCs (GB350 backlight).
```

## kernel/sound/hichip/Kconfig
```kconfig
config SND_HC16XX
	bool "HiChip HC16xx I2S output (GB350)"
	depends on SND && OF && HAS_DMA
	select SND_PCM
	help
	  ALSA driver for the I2S output DMA of HiChip HC16xx SoCs, as wired
	  to the CS4344 DAC of the GB350 handheld.
```
